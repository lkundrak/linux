## Documentation/devicetree/bindings/fb/brcm,bcm2835-fb.txt
```
Broadcom BCM2835 framebuffer

Required properties:

- compatible : should be "brcm,bcm2835-fb"
- brcm,bcm2835-mbox : mailbox used to set up the framebuffer

Example:

fb {
	compatible = "brcm,bcm2835-fb";
	brcm,bcm2835-mbox = <&mailbox>;
};
```

## Documentation/devicetree/bindings/mailbox/brcm,bcm2835-mbox.txt
```
Broadcom BCM2835 VideoCore mailbox IPC

Required properties:

- compatible : should be "brcm,bcm2835-mbox"
- reg : Specifies base physical address and size of the registers.
- interrupts : the interrupt number

Example:

mailbox {
	compatible = "brcm,bcm2835-mbox";
	reg = <0x7e00b800 0x400>;
	interrupts = <0 1>;
};
```

## Documentation/devicetree/bindings/thermal/brcm,bcm2835-thermal.txt
```
Broadcom BCM2835 thermal sensor

Required properties:

- compatible : should be "brcm,bcm2835-thermal"
- brcm,bcm2835-mbox : mailbox used to talk to the thermal sensor

Example:

thermal {
	compatible = "brcm,bcm2835-thermal";
	brcm,bcm2835-mbox = <&mailbox>;
};
```

## drivers/char/netvista/Kconfig
```kconfig
config IBM_NETVISTA
	tristate "IBM NetVista Drivers"
	depends on EXPERIMENTAL && PCI
	---help---
	  This is the reboot/poweroff driver for the IBM NetVista 2200 and 
	  2800 (if booted in nsboot mode).
	  If unsure, say N.
```
